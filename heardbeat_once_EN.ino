#include "U8glib.h"

#define precision 15000  //15secs

U8GLIB_SSD1306_128X64 u8g(U8G_I2C_OPT_NONE);  
 
const uint8_t heart[] PROGMEM = {
0x00,0x00,0x00,0x00,0x00,0x00,0x00,0x00,    
0x00,0x00,0x00,0x00,0x00,0x00,0x00,0x00,
0x00,0x00,0x00,0x00,0x00,0x00,0x00,0x00,  
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0x00,0x00,0x00,0x00,0x00,0x00,
};

const uint8_t cover_heart[] PROGMEM = {
0x00,0x00,0x00,0x00,0x00,0x00,0x00,0x00,
0x00,0x00,0x00,0x00,0x00,0x00,0x00,0x00,
0x00,0x00,0x00,0x00,0x00,0x00,0x00,0x00,
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0x00,0x00,0x00,0x00,0x00,0x00,
};


unsigned long time,heart_time;
unsigned long lastBeatTime = 0; 
int heartbeat = 0;
boolean condition = false;

void isr(){ 
  heart_time = time; 
  int deburring = heart_time - lastBeatTime; 
      //Serial.println(deburring);
       if((deburring>400)&&(deburring<1000)){  
       heartbeat = heartbeat+1;       
       }
       lastBeatTime = heart_time;        
  u8g.firstPage();            
   do {  
     draw(); 
   }  
    while( u8g.nextPage() );  
  condition = true ;
  }    
     
void setup(){
  Serial.begin(115200);     
  attachInterrupt(0,isr,RISING);
}

void loop(){             
   time = millis();                     
      
   if(condition){       
       u8g.firstPage();            
   do {        
     draw1();
    } while( u8g.nextPage() );    
   }
        
    if( heart_time>precision){ 
     condition = false;  
     detachInterrupt(0);
     u8g.firstPage();            
   do {                
      draw2();        
     }  while( u8g.nextPage() );                                       
    }       
   }
                 
 void draw(){
   u8g.drawXBMP( 40, 0, 40, 30, cover_heart);
 }
  
 void draw1(){
   u8g.drawXBMP( 40, 0, 40, 30, heart); 
     u8g.setPrintPos(32, 50);  
      u8g.print("Time:");
        u8g.setFont(u8g_font_9x18B);
       u8g.print(int(time/1000));
      u8g.setFont(u8g_font_7x14);
    u8g.print("S");
 }

  void draw2(){   
    u8g.setFont(u8g_font_9x18B);
    u8g.setPrintPos(5, 15); 
    u8g.print("HEARTBEAT:");
     u8g.setFont(u8g_font_fub20);
    u8g.setPrintPos(30, 50); 
    u8g.print(heartbeat*60000/precision);
    u8g.setFont(u8g_font_9x18B);
    u8g.setPrintPos(80, 50);  
    u8g.print("N/S");
 } 

 

